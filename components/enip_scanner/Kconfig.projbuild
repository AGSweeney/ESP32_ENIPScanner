## components/enip_scanner/Kconfig.projbuild
```kconfig
# ENIP Scanner Configuration

menu "EtherNet/IP Scanner Configuration"

    config ENIP_SCANNER_ENABLE_DEBUG_LOGS
        bool "Enable debug logging"
        default n
        help
            Enable verbose debug logging for EtherNet/IP scanner operations.
            This can be useful for troubleshooting but will increase log output.

    config ENIP_SCANNER_MAX_DEVICES
        int "Maximum number of devices to scan"
        range 1 256
        default 32
        help
            Maximum number of devices that can be discovered in a single scan operation.

    config ENIP_SCANNER_DEFAULT_TIMEOUT_MS
        int "Default timeout (milliseconds)"
        range 1000 60000
        default 5000
        help
            Default timeout for EtherNet/IP operations in milliseconds.

    config ENIP_SCANNER_ENABLE_TAG_SUPPORT
        bool "Enable Allen-Bradley tag support"
        default n
        help
            Enable support for reading/writing Allen-Bradley tags (Micro800, CompactLogix, etc.).
            This adds tag-specific functions but increases code size.
            Note: Tag names must be known in advance (no tag discovery/browsing).

    config ENIP_SCANNER_ENABLE_MOTOMAN_SUPPORT
        bool "Enable Motoman robot CIP class support"
        default n
        help
            Enable support for reading/writing Motoman vendor-specific CIP classes (0x70-0x81).
            This adds functions for robot status, I/O, variables, and registers.
            Reference: Motoman Manual 165838-1CD, Section 5.2

    config ENIP_SCANNER_ENABLE_IMPLICIT_SUPPORT
        bool "Enable implicit messaging (I/O data) support"
        default y
        help
            Enable support for EtherNet/IP implicit messaging (Class 1 I/O data).
            This adds functions for establishing bidirectional implicit connections using
            Forward Open/Close and UDP-based cyclic I/O data exchange.
            Uses UDP port 2222 for implicit I/O and TCP port 44818 for Forward Open/Close.
            Reference: EtherNet/IP Implicit Messaging Implementation Guide

endmenu
```

## main/Kconfig.projbuild
```kconfig
menu "Ethernet Configuration"
    config OPENER_ETH_PHY_ADDR
        int "Ethernet PHY address"
        range 0 31
        default 1
    config OPENER_ETH_PHY_RST_GPIO
        int "Ethernet PHY reset GPIO"
        default 51
    config OPENER_ETH_MDC_GPIO
        int "Ethernet MDC GPIO"
        default 31
    config OPENER_ETH_MDIO_GPIO
        int "Ethernet MDIO GPIO"
        default 52
endmenu
```

## sdkconfig.defaults
```kconfig
# Enable custom partition table for OTA support
CONFIG_PARTITION_TABLE_CUSTOM=y
CONFIG_PARTITION_TABLE_CUSTOM_FILENAME="partitions.csv"

# Enable OTA support
CONFIG_BOOTLOADER_APP_ROLLBACK_ENABLE=y

# Enable L2 TAP support for raw Ethernet frame handling
CONFIG_ESP_NETIF_L2_TAP=y

# Enable HTTP server for Web UI
CONFIG_HTTPD_MAX_REQ_HDR_LEN=1024
CONFIG_HTTPD_MAX_URI_LEN=512

# LWIP Optimization for EtherNet/IP Application
# Reduce TCP buffer sizes (EtherNet/IP uses small packets, typically < 100 bytes)
CONFIG_LWIP_TCP_SND_BUF_DEFAULT=8192
CONFIG_LWIP_TCP_WND_DEFAULT=8192

# Reduce TCP connection limits (still has plenty of headroom for max 8 implicit + HTTP + explicit ops)
CONFIG_LWIP_MAX_ACTIVE_TCP=32
CONFIG_LWIP_MAX_LISTENING_TCP=4

# Reduce FIN wait timeout for faster connection cleanup (important for frequent explicit messaging)
CONFIG_LWIP_TCP_FIN_WAIT_TIMEOUT=5000

# Keep TCP timer at 250ms for balanced performance/latency
# CONFIG_LWIP_TCP_TMR_INTERVAL=250 is default, no change needed
```
